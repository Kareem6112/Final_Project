/*
 * TFT_prog.c
 *
 * Created: 5/20/2025 8:26:31 PM
 *  Author: kareem
 */ 
#include "../../LIB/BIT_MATH.h"
#include "../../LIB/STD_TYPES.h"
#include "../../MCAL/SPI/SPI_interface.h"
#include "TFT_interface.h"
#include "avr/io.h"
#define F_CPU 16000000UL
#include "util/delay.h"
void ILI9341_Init()
{
	// Set control pins as output
	DDRC |= (1 << ILI9341_DC_PIN) | (1 << ILI9341_RST_PIN) | (1 << ILI9341_CS_PIN);
	
	// Reset the display
	PORTC &= ~(1 << ILI9341_RST_PIN);
	_delay_ms(50);
	PORTC |= (1 << ILI9341_RST_PIN);
	_delay_ms(50);
	
	// Send initialization commands
	ILI9341_SendCommand(ILI9341_CMD_RESET);
	_delay_ms(120);
	ILI9341_SendCommand(ILI9341_CMD_SLEEP_OUT);
	_delay_ms(120);
	ILI9341_SendCommand(ILI9341_CMD_DISPLAY_ON);
	_delay_ms(50);
	ILI9341_SendCommand(ILI9341_CMD_PIXEL_FORMAT_SET);
	ILI9341_SendData(0x55); // 16-bit color
	_delay_ms(10);
}

void ILI9341_SendCommand(u8 cmd)
{
	// Set DC low for command mode
	PORTC &= ~(1 << ILI9341_DC_PIN);
	// Select the display
	PORTC &= ~(1 << ILI9341_CS_PIN);
	// Send the command
	SPI_voidMasterSendData(cmd);
	// Deselect the display
	PORTC |= (1 << ILI9341_CS_PIN);
}

void ILI9341_SendData(u8 data)
{
	// Set DC high for data mode
	PORTC |= (1 << ILI9341_DC_PIN);
	// Select the display
	PORTC &= ~(1 << ILI9341_CS_PIN);
	// Send the data
	SPI_voidMasterSendData(data);
	// Deselect the display
	PORTC |= (1 << ILI9341_CS_PIN);
}

void ILI9341_FillScreen(u16 color)
{
	ILI9341_SendCommand(ILI9341_CMD_MEMORY_WRITE);
	for (u64 i = 0; i <  320UL * 240; i++)
	{
		ILI9341_SendData(color >> 8);   // Send high byte
		ILI9341_SendData(color & 0xFF); // Send low byte
	}
}


void ILI9341_SetAddressWindow(u16 x0, u16 y0, u16 x1, u16 y1)
{
	ILI9341_SendCommand(0x2A); // Column address set
	ILI9341_SendData(x0 >> 8);
	ILI9341_SendData(x0 & 0xFF);
	ILI9341_SendData(x1 >> 8);
	ILI9341_SendData(x1 & 0xFF);

	ILI9341_SendCommand(0x2B); // Row address set
	ILI9341_SendData(y0 >> 8);
	ILI9341_SendData(y0 & 0xFF);
	ILI9341_SendData(y1 >> 8);
	ILI9341_SendData(y1 & 0xFF);

	ILI9341_SendCommand(0x2C); // Memory write
}
void ILI9341_DrawPixel(u16 x, u16 y, u16 color)
{
	ILI9341_SetAddressWindow(x, y, x, y);
	ILI9341_SendData(color >> 8);
	ILI9341_SendData(color & 0xFF);
}

const uint8_t font_5x7[96][5] = {
	{0x00,0x00,0x00,0x00,0x00}, // ' ' 0x20
	{0x00,0x00,0x5F,0x00,0x00}, // '!' 0x21
	{0x00,0x07,0x00,0x07,0x00}, // '"' 0x22
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	{0x08,0x1C,0x2A,0x08,0x08}  // DEL 0x7F (usually unused)
};

void ILI9341_DrawChar(u16 x, u16 y, char c, u16 color, u16 bg, u8 size)
{
	for (u8 i = 0; i < 5; i++) {
		u8 line = font_5x7[(u8)c][i];
		for (u8 j = 0; j < 8; j++) {
			if (line & 0x01) {
				// Draw pixel (scale by size)
				for (u8 xs = 0; xs < size; xs++) {
					for (u8 ys = 0; ys < size; ys++) {
						ILI9341_DrawPixel(x + i*size + xs, y + j*size + ys, color);
					}
				}
				} else {
				for (u8 xs = 0; xs < size; xs++) {
					for (u8 ys = 0; ys < size; ys++) {
						ILI9341_DrawPixel(x + i*size + xs, y + j*size + ys, bg);
					}
				}
			}
			line >>= 1;
		}
	}
}

void ILI9341_voidWriteString(u16 x, u16 y, u16 color, u16 bg, u8 size,const char *str)
{
	while(*str != nul)
	{
		ILI9341_DrawChar(x, y,(*str)-32,color,bg,size);
		x-=20;
		
		str++;
	}
	
}

